## main/Kconfig.projbuild
```kconfig
menu "Application Configuration"

	menu "WiFi Setting"

		config ESP_WIFI_SSID
			string "WiFi SSID"
			default "myssid"
			help
				SSID (network name) to connect to.

		config ESP_WIFI_PASSWORD
			string "WiFi Password"
			default "mypassword"
			help
				WiFi password (WPA or WPA2) to connect to.

		config ESP_MAXIMUM_RETRY
			int "Maximum retry"
			default 5
			help
				Set the Maximum retry to avoid station reconnecting to the AP unlimited when the AP is really inexistent.

		config MDNS_HOSTNAME
			string "mDNS Hostname"
			default "esp32-camera"
			help
				The mDNS host name used by the ESP32.

		config STATIC_IP
			bool "Enable Static IP Address"
			default false
			help
				Enable Static IP Address.

		config STATIC_IP_ADDRESS
			depends on STATIC_IP
			string "Static IP Address"
			default "192.168.10.100"
			help
				Static IP Address for Station.

		config STATIC_GW_ADDRESS
			depends on STATIC_IP
			string "Static GW Address"
			default "192.168.10.1"
			help
				Static GW Address for Station.

		config STATIC_NM_ADDRESS
			depends on STATIC_IP
			string "Static Netmask"
			default "255.255.255.0"
			help
				Static Netmask for Station.

	endmenu

	menu "HTTP Server Setting"

		config WEB_SERVER
			string "HTTP Server"
			default "myhttpserver.local"
			help
				The host name or IP address of the HTTP server to use.

		config WEB_PORT
			string "HTTP Port"
			default "8080"
			help
				HTTP server port to use.

		config WEB_PATH
			string "HTTP Url"
			default "/upload_multipart"
			help
				HTTP Server url to use.

	endmenu

	menu "Attached File Name Setting"

		choice REMOTE_FILE
			bool "Select attached file name"
			default REMOTE_IS_FIXED_NAME
			help
				Select attached file name.

			config REMOTE_IS_FIXED_NAME
				bool "Attached file name is fixed"
			config REMOTE_IS_VARIABLE_NAME
				bool "Attached file name is date and time"
		endchoice

		config FIXED_REMOTE_FILE
			depends on REMOTE_IS_FIXED_NAME
			string "Fixed-Attached file name"
			default "picture.jpg"
			help
				Attached file name.

		config NTP_SERVER
			depends on REMOTE_IS_VARIABLE_NAME
			string "NTP Server"
			default "pool.ntp.org"
			help
				Hostname for NTP Server.

		config LOCAL_TIMEZONE
			depends on REMOTE_IS_VARIABLE_NAME
			int "Your TimeZone"
			range -23 23
			default 0
			help
				Your local timezone.  When it is 0, Greenwich Mean Time.

		config REMOTE_FRAMESIZE
			bool "Add FrameSize to Remote file name"
			default false
			help
				Add FrameSize to Remote file name.

	endmenu

	choice BOARD
		bool "Select Board"
		default BOARD_ESP32CAM_AITHINKER
		help
			Select Board Type.

		config BOARD_ESP32_WROVER_FREENOVE
			bool "Freenove ESP32-WROVER CAM Board"
		config BOARD_ESP32S3_WROOM_FREENOVE
			bool "Freenove ESP32S3-WROOM CAM Board"
		config BOARD_CAMERA_MODEL_ESP_EYE
			bool "Espressif ESP-EYE"
		config BOARD_ESP32CAM_AITHINKER
			bool "AiThinker ESP32-CAM"
		config BOARD_CAMERA_MODEL_TTGO_T_JOURNAL
			bool "TTGO T-Journal ESP32 Camera"
		config BOARD_ESPS3_CAM_UICPAL
			bool "UICPAL ESPS3 CAM RE:1.0"
	endchoice

	choice FRAMESIZE
		bool "Select Frame Size"
		default FRAMESIZE_VGA
		help
			Select Picture Frame Size.

		config FRAMESIZE_VGA
			bool "Frame Size:640x480"
		config FRAMESIZE_SVGA
			bool "Frame Size:800x600"
		config FRAMESIZE_XGA
			bool "Frame Size:1024x768"
		config FRAMESIZE_HD
			bool "Frame Size:1280x720"
		config FRAMESIZE_SXGA
			bool "Frame Size:1280x1024"
		config FRAMESIZE_UXGA
			bool "Frame Size:1600x1200"
	endchoice

	menu "Select Shutter"

		choice SHUTTER_SELECT
			bool "Select Shutter"
			default SHUTTER_ENTER
			help
				Selecting the shutter method

			config SHUTTER_ENTER
				bool "Use Enter key"
			config SHUTTER_GPIO
				bool "Use GPIO"
			config SHUTTER_TCP
				bool "Use TCP Socket"
			config SHUTTER_UDP
				bool "Use UDP Socket"
			config SHUTTER_HTTP
				bool "Use HTTP Request"

		endchoice

		config GPIO_INPUT
			int "Input GPIO number"
			depends on SHUTTER_GPIO
			range 4 34
			default 15
			help
				GPIO number (IOxx) to Button Input.
				Some GPIOs are used for other purposes (flash connections, etc.) and cannot be used to Button.

		choice GPIO_INITIAL
			prompt "GPIO Initial state"
			depends on SHUTTER_GPIO
			default GPIO_PULLDOWN
			help
				Select initial state of GPIO.

			config GPIO_PULLUP
				bool "GPIO_PULLUP"
				help
					The initial state of GPIO is Pull-UP.

			config GPIO_PULLDOWN
				bool "GPIO_PULLDOWN"
				help
					The initial state of GPIO is Pull-Down.

		endchoice


		config TCP_PORT
			int "TCP Port"
			depends on SHUTTER_TCP
			range 49152 65535
			default 49876
			help
				Local port TCP server will listen on.

		config UDP_PORT
			int "UDP Port"
			depends on SHUTTER_UDP
			range 49152 65535
			default 49876
			help
				Local port UDP server will listen on.

		config SHUTTER_URL
			string "URL for built-in WEB server"
			depends on SHUTTER_HTTP
			default "/take/picture"
			help
				URL for built-in WEB server.
				Must start with /.

	endmenu

	config ENABLE_FLASH
		bool "Enable Flash Light"
		help
			Enable Flash Light.

	config GPIO_FLASH
		int "Flash GPIO number"
		depends on ENABLE_FLASH
		range 4 34
		default 4
		help
			GPIO number (IOxx) to Button Input.
			Some GPIOs are used for other purposes (flash connections, etc.) and cannot be used to Button.

endmenu
```

## sdkconfig.defaults
```kconfig
#
# Serial flasher config
#
CONFIG_ESPTOOLPY_FLASHFREQ_80M=y
CONFIG_ESPTOOLPY_FLASHSIZE_4MB=y

#
# ESP System Settings
#
CONFIG_ESP_MAIN_TASK_STACK_SIZE=8192

#
# Partition Table
#
CONFIG_PARTITION_TABLE_CUSTOM=y
CONFIG_PARTITION_TABLE_CUSTOM_FILENAME="partitions.csv"
CONFIG_PARTITION_TABLE_FILENAME="partitions.csv"

#
# ESP32-specific
#
CONFIG_ESP32_DEFAULT_CPU_FREQ_240=y
CONFIG_ESP32_DEFAULT_CPU_FREQ_MHZ=240
CONFIG_ESP32_SPIRAM_SUPPORT=y

#
# ESP32S3-specific
#
CONFIG_ESP32S3_DEFAULT_CPU_FREQ_240=y
CONFIG_ESP32S3_DEFAULT_CPU_FREQ_MHZ=240
CONFIG_ESP32S3_SPIRAM_SUPPORT=y

#
# mDNS
#
CONFIG_MDNS_STRICT_MODE=y

#
# Camera configuration
#
#CONFIG_OV7670_SUPPORT=y
#CONFIG_OV7725_SUPPORT=y
#CONFIG_NT99141_SUPPORT=y
CONFIG_OV2640_SUPPORT=y
#CONFIG_OV3660_SUPPORT=y
#CONFIG_OV5640_SUPPORT=y
CONFIG_CAMERA_NO_AFFINITY=y
CONFIG_SCCB_HARDWARE_I2C_PORT0=y
```
